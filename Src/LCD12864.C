
#include "LCD12864.h"
/*
****************************************************
*  File name          : LCD12864.c
*  Author             : 5A4A5943
*  Version            : V1.0
*  Date               : 
*  Description        : 
*  Function List      : 
						void LCD12864_Init(void)
						void LCD12864_ClearScreen(uint8_t Data)
						void LCD12864_TestDisplay(uint8_t Data1,uint8_t Data2)
						void LCD12864_Graphic(uint16_t X_Start,uint16_t X_End,uint16_t Y_Start,uint16_t Y_End,uint8_t * Buff)
						uint8_t LCD12864RamWrite(uint16_t X_Start,uint16_t X_End,uint16_t Y_Start,uint16_t Y_End,uint8_t * Buff)
						uint8_t LCD12864Sync(void)
						uint8_t LCD12864SetPixel(uint8_t x,uint8_t y,uint8_t color)
*  History            : 
						2016--08--22--11--04--29：
						添加画点函数LCD12864SetPixel并测试成功
						
*****************************************************
*/
#include <Ctype.h>
#include "LCD12864.h"
void LCD12864_Delay(uint8_t i);

uint8_t  ascii_table_8x16[95][16];
uint8_t  ascii_table_5x8[95][5];
uint8_t  cheng1[];
uint8_t  gong1[];
uint8_t  zhuang1[];
uint8_t  tai1[];
uint8_t  shi1[];
uint8_t  yong1[];
uint8_t  bmp_12864_1[];

extern FONT_MANAGE FontManage3232;
extern FONT_MANAGE FontManage1616;

JLX12864G_	JLX12864G = {0x00};
FONT_MANAGE	FontManage = {0x00};

/*
****************************************************
*  Function       : LinkAdd
*  Description    : 添加链表
*  Calls          : 
*  Called By      : 
*  Input          : Head：链表头  Added：新加元素
*  Output         : 
*  Return         : 失败返回非 0 值
*  Others         : 
*****************************************************
*/
uint8_t LinkAdd(pFONT_MANAGE Head,pFONT_MANAGE Added)
{
	pFONT_MANAGE Temp = Head;
	uint8_t Cnt = 0;
	
	while(Temp->NEXT != 0x00 && Cnt++ < 128)Temp = Temp->NEXT;
	
	if(Cnt < 128)
	{
		Temp->NEXT = Added;
		return 0x00;
	}
	return Cnt;
}

uint8_t FontInit(void)
{
	memset((uint8_t *) &FontManage,0,sizeof(FONT_MANAGE));
	LinkAdd(&FontManage,&FontManage3232);
	LinkAdd(&FontManage,&FontManage1616);
}
/*
****************************************************
*  Function       : 
*  Description    : 
*  Calls          : 
*  Called By      : 
*  Input          : 
*  Output         : 
*  Return         : 
*  Others         : 
*****************************************************
*/
uint32_t FontSearch(
						uint8_t * Char,
						uint32_t * Index,
						uint8_t * Buff,
						uint8_t H,
						uint8_t W,
						FontType_ Type
					)
{
	pFONT_MANAGE Temp = &FontManage;
	uint32_t Size = 0;
research:
	{
		if(Temp->H == H && Temp->W == W)
		{
			Size = Temp->GetFont(Char,Index,Buff,Type);
			if(Size != 0x00)return Size;
		}
	}
	if(Temp->NEXT != 0x00)
	{
		Temp = Temp->NEXT;
		goto research;
	}
	return 0x00;
}

void LCD12864_DisplayHanZi3232String(uint8_t * Str,uint32_t x,uint8_t y)
{
	uint8_t Char[2] = 0,x_Start = x,y_Start = y;
	uint32_t Index = 0,Size = 0;
	do
	{
		Char[0] = Str[0];
		Char[1] = Str[1];
		
		Size = FontSearch(Char,&Index,0x00,32,32,Array);
		
		if(Size != 0x00)
		{
			LCD12864_Graphic(x_Start,x_Start + 31,y_Start,y_Start + 31,(uint8_t *)Index);
		}
		
		Str += 2;
		//x_Start += 32;
		y_Start += 32;
	}while(*Str != 0x00);
}

/*
****************************************************
*  Function       : LCD12864LLInit
*  Description    : 底层初始化
*  Calls          : 
*  Called By      : 
*  Input          : 
*  Output         : 
*  Return         : 
*  Others         : 
*****************************************************
*/
uint8_t LCD12864LLInit(void)
{
	MX_GPIO_Init();
}

/*
****************************************************
*  Function       : LCD12864_Command
*  Description    : 向LCD发送命令
*  Calls          : 
*  Called By      : 
*  Input          : Data:
*  Output         : 
*  Return         : 
*  Others         : 
*****************************************************
*/
void LCD12864_Command(uint8_t Data)
{
	LCD12864_CS(LOW);
	LCD12864_RS(LOW);
	LCD12864_RD(LOW);
	LCD12864_WR(LOW);
	LCD12864_DATA(Data);
	LCD12864_RD(HIGH);
	LCD12864_CS(HIGH);
	LCD12864_RD(LOW);
}
/*
****************************************************
*  Function       : LCD12864_Data
*  Description    : 向LCD发送数据
*  Calls          : 
*  Called By      : 
*  Input          : Data:
*  Output         : 
*  Return         : 
*  Others         : 
*****************************************************
*/
void LCD12864_Data(uint8_t Data)
{
	LCD12864_CS(LOW);
	LCD12864_RS(HIGH);
	LCD12864_RD(LOW);
	LCD12864_WR(LOW);
	LCD12864_DATA(Data);
	LCD12864_RD(HIGH);
	LCD12864_CS(HIGH);
	LCD12864_RD(LOW);
}
/*
****************************************************
*  Function       : LCD12864_Delay
*  Description    : 简单延迟函数，延迟精度未知
*  Calls          : 
*  Called By      : 
*  Input          : 
*  Output         : 
*  Return         : 
*  Others         : 
*****************************************************
*/
void LCD12864_Delay(uint8_t cnt)
{
	while(cnt --);
}

/*
****************************************************
*  Function       : LCD12864_Init
*  Description    : 初始化LCD
*  Calls          : 
*  Called By      : 
*  Input          : 
*  Output         : 
*  Return         : 
*  Others         : 
*****************************************************
*/
void LCD12864_Init(void)
{
	LCD12864LLInit();
	
	LCD12864_CS(LOW);
	
	/*低电平复位*/
	LCD12864_RES(LOW); 
	LCD12864_Delay(20);
	 /*复位完毕*/
	LCD12864_RES(HIGH);
	
	LCD12864_Delay(20);
	/*软复位*/
	LCD12864_Command(0xe2); 
	LCD12864_Delay(50);
	/*升压步聚 1*/
	LCD12864_Command(0x2c); 
	LCD12864_Delay(50);
	/*升压步聚 2*/
	LCD12864_Command(0x2e); 
	LCD12864_Delay(50);
	/*升压步聚 3*/
	LCD12864_Command(0x2f); 
	LCD12864_Delay(50);
	/*粗调对比度，可设置范围 0x20～0x27*/
	LCD12864_Command(0x24); 
	/*微调对比度*/
	LCD12864_Command(0x81); 
	/*0x1a,微调对比度的值，可设置范围 0x00～0x3f 1f*/
	LCD12864_Command(0x1a); 
	/*1/9 偏压比（bias）*/
	LCD12864_Command(0xa2);
	/*行扫描顺序：从上到下*/	
	LCD12864_Command(0xc0); 
	/*列扫描顺序：从左到右*/
	LCD12864_Command(0xa1); 
	/*起始行：第一行开始*/
	LCD12864_Command(0x40);
	/* 清空显示 */
	LCD12864_ClearScreen(0x00);
	/*开显示*/	
	LCD12864_Command(0xaf); 
	
	LCD12864_CS(HIGH);
}
/*
****************************************************
*  Function       : LCD12864_Addr
*  Description    : 设定地址
*  Calls          : 
*  Called By      : 
*  Input          : 
						page(1~8):页地址
						column(1~128)
*  Output         : 
*  Return         : 
*  Others         : 
*****************************************************
*/
void LCD12864_Addr(uint8_t page,uint8_t column)
{
	LCD12864_CS(LOW);
	column = column + 3;
	page = page - 1;
	LCD12864_Command(0xb0 + page); 
	/*设置页地址。每页是 8 行。一个画面的 64 行被分成 8 个页。我们平常所说
	的第 1 页，在 LCD 驱动 IC 里是第 0 页，所以在这里减去 1*/
	LCD12864_Command(((column>>4)&0x0f)+0x10); //设置列地址的高 4 位
	LCD12864_Command(column&0x0f); //设置列地址的低 4 位
}
/*
****************************************************
*  Function       : LCD12864_ClearScreen
*  Description    : 清屏
*  Calls          : 
*  Called By      : 
*  Input          : 
*  Output         : 
*  Return         : 
*  Others         : 
*****************************************************
*/
void LCD12864_ClearScreen(uint8_t Data)
{
	uint8_t i,j;
	
	for(i = 0;i < 8;i ++)
	{
		for(j = 0;j < 128;j ++)
		{
			JLX12864G.LcdRam[i][j] = Data;
		}
	}
	
	for(i = 0;i < 8;i ++)
	{
		for(j = 0;j < 2;j ++)
		{
			JLX12864G.BitMapNeedUpdate[i][j] = 0xFF;
		}
	}
	
	LCD12864Sync();
}
/*
****************************************************
*  Function       : LCD12864_TestDisplay
*  Description    : LCD测试屏幕
*  Calls          : 
*  Called By      : 
*  Input          : Data1:第一个数据Data2:第二个数据
*  Output         : 
*  Return         : 
*  Others         : 
*****************************************************
*/
void LCD12864_TestDisplay(uint8_t Data1,uint8_t Data2)
{
	uint8_t i,j;
	
	for(i = 0;i < 8;i ++)
	{
		for(j = 0;j < 128;j ++)
		{
			JLX12864G.LcdRam[i][j] = j % 2 == 0 ? Data1:Data2;
		}
	}
	for(i = 0;i < 8;i ++)
	{
		for(j = 0;j < 2;j ++)
		{
			JLX12864G.BitMapNeedUpdate[i][j] = 0xFF;
		}
	}

	LCD12864Sync();
}
/*
****************************************************
*  Function       : LCD12864_Graphic
*  Description    : 显示一幅128*64的图片
*  Calls          : 
*  Called By      : 
*  Input          : 
					X_Start:1-64
					X_End:1-64
					Y_Start:1-128
					Y_End:1-128
*  Output         : 
*  Return         : 
*  Others         : 
						ZJYC:一定要注意你取得字模的大小，否则显示出问题！！！！！！！！！！！！！
						有些软件说是32*32的其实是31*31的！！！！！！！！！！！
*****************************************************
*/
void LCD12864_Graphic(uint16_t X_Start,uint16_t X_End,uint16_t Y_Start,uint16_t Y_End,uint8_t * Buff)
{
	LCD12864RamWrite(X_Start,X_End,Y_Start,Y_End,Buff);
	LCD12864Sync();
}
/*
****************************************************
*  Function       : LCD12864_Graphic1616
*  Description    : 显示16*16点阵
*  Calls          : 
*  Called By      : 
*  Input          : 
*  Output         : 
*  Return         : 
*  Others         : 
*****************************************************
*/
#define LCD12864_Graphic1616(x,y,buf)	LCD12864_Graphic((x),(x)+15,(y),(y)+15,buf)
/*
****************************************************
*  Function       : LCD12864_Graphic3232
*  Description    : 显示32*32点阵
*  Calls          : 
*  Called By      : 
*  Input          : 
*  Output         : 
*  Return         : 
*  Others         : 
*****************************************************
*/
#define LCD12864_Graphic3232(x,y,buf)	LCD12864_Graphic((x),(x)+31,(y),(y)+31,buf)
/*
****************************************************
*  Function       : LCD12864_Graphic2424
*  Description    : 显示24*24点阵
*  Calls          : 
*  Called By      : 
*  Input          : 
*  Output         : 
*  Return         : 
*  Others         : 
*****************************************************
*/
#define LCD12864_Graphic2424(x,y,buf)	LCD12864_Graphic((x),(x)+23,(y),(y)+23,buf)

/*
****************************************************
*  Function       : LCD12864_Graphic0816
*  Description    : 显示8*16点阵
*  Calls          : 
*  Called By      : 
*  Input          : 
*  Output         : 
*  Return         : 
*  Others         : 
*****************************************************
*/
#define LCD12864_Graphic0816(x,y,buf)	LCD12864_Graphic((x),(x)+7,(y),(y)+15,buf)

/*
****************************************************
*  Function       : LCD12864_Graphic0508
*  Description    : 显示5*8点阵
*  Calls          : 
*  Called By      : 
*  Input          : 
*  Output         : 
*  Return         : 
*  Others         : 
*****************************************************
*/
#define LCD12864_Graphic0508(x,y,buf)	LCD12864_Graphic((x),(x)+4,(y),(y)+7,buf)
/*
****************************************************
*  Function       : LCD12864_Test
*  Description    : 测试LCD
*  Calls          : 
*  Called By      : 
*  Input          : 
*  Output         : 
*  Return         : 
*  Others         : 
*****************************************************
*/
void LCD12864_Test(void)
{
	uint8_t Buff[16] = {0xff,0xff,0xff,0xff,0xff,0xff,0xff,0xff,0xff,0xff,0xff,0xff,0xff,0xff,0xff,0xff};
	uint8_t i,j;
	LCD12864_Init();
	FontInit();
	LCD12864SetPixel(1,1,0xFF);  LCD12864Sync();
	LCD12864SetPixel(64,1,0xFF);LCD12864Sync();
	LCD12864SetPixel(1,128,0xFF); LCD12864Sync();
	LCD12864SetPixel(64,128,0xFF);LCD12864Sync();
	LCD12864SetPixel(32,64,0xFF);  
	LCD12864Sync();
	LCD12864RamWrite(2,9,2,17,Buff);
	LCD12864RamWrite(5,12,20,20 + 15,Buff);
	LCD12864RamWrite(9,16,43,43 + 15,Buff);
	LCD12864RamWrite(20,27,98,98 + 15,Buff);
	LCD12864RamWrite(40,47,72,72 + 15,Buff);
	LCD12864Sync();
	LCD12864_ClearScreen(0x00);
	LCD12864_TestDisplay(0x55,0xaa);
	LCD12864_ClearScreen(0x00);
	LCD12864_Graphic(1,64,1,128,bmp_12864_1);
	LCD12864_ClearScreen(0x00);
	LCD12864_Graphic(1,31,1,31,cheng1);
	LCD12864_ClearScreen(0x00);
	LCD12864_Graphic(1,16,1,16,zhuang1);
	LCD12864_ClearScreen(0x00);
	LCD12864_Graphic(1,31,1,31,gong1);
	
	LCD12864_ClearScreen(0x00);
	
	
	LCD12864_DisplayHanZi3232String("神思电子",1,1);
	
	
	//LCD12864_Graphic3232(1,1,StrJingE[0]);
	//LCD12864_Graphic3232(1,33,StrJingE[1]);
	while(1)
	{
		;
	}
}
/*
****************************************************
*  Function       : LCD12864RamWrite
*  Description    : 将数据写入显存
*  Calls          : 
*  Called By      : 
*  Input          : 
						X_Start:1-64
						X_End:1-64
						Y_Start:1-128
						Y_End:1-128
						Buff:数据缓冲
*  Output         : 
						改变了JLX12864G的BitMapNeedUpdate和BitMapCrack
*  Return         : 成功返回0
*  Others         : 写此函数的初衷：（1）使用显存后期方便调试和管理
					（2）解决了因只能8位写入而造成的一些阻碍
					2016--08--22--11--15--59：
					修正BUG：不能画（x,128）的点
*****************************************************
*/
uint8_t LCD12864RamWrite(uint16_t X_Start,uint16_t X_End,uint16_t Y_Start,uint16_t Y_End,uint8_t * Buff)
{
	uint16_t i,j,k = 0,m = 0,n = 0,l = 0;
	uint8_t Temp;
	
	//越界返回错误
	if(X_End > 64 || X_Start > 64 || Y_End > 128 || Y_Start > 128)return 0x01;
	
	X_Start--;
	X_End--;
	Y_Start--;
	Y_End--;
	
	l =  Y_End - Y_Start + 1;
	
	for(i = X_Start;i <= X_End;i ++,n ++)
	{
		k = (n / 8) * l;
		for(j = Y_Start;j <= Y_End;j ++)
		{
			/* 位图 */
			JLX12864G.BitMapNeedUpdate[i / 8][j / 8 / 8] |= ( 1 << (j > 64 ? (j - 64) / 8 : j / 8));
			/* 填充显存 */
			Temp = JLX12864G.LcdRam[i / 8][j];
			Temp |= (*(Buff + k) & (1 << ((i) % 8))) ? (1 << ((i) % 8)) : 0;
			JLX12864G.LcdRam[i / 8][j] = Temp;
			k++;
		}
	}
	
	return 0x00;
}
/*
****************************************************
*  Function       : LCD12864Sync
*  Description    : 同步显存到LCD
*  Calls          : 
*  Called By      : 
*  Input          : 
*  Output         : 
*  Return         : 
*  Others         : 依据BitMapNeedUpdate信息
					2016--08--22--11--14--00:
					发现LCD的一个轻微缺陷（BUG）只要是拉低CS，过一会再拉高，LCD就会画一个点
*****************************************************
*/
uint8_t LCD12864Sync(void)
{
	uint16_t i,j,k,m;
	
	for(i = 0;i < 8;i ++)
	{
		for(j = 0;j < 2;j ++)
		{
			if(JLX12864G.BitMapNeedUpdate[i][j] == 0)continue;
			
			for(k = 0;k < 8;k ++)
			{
				if(JLX12864G.BitMapNeedUpdate[i][j] & (1 << k))
				{
					LCD12864_CS(LOW);
					LCD12864_Addr(i + 1,8 * (j * 8 + k) + 1);
					for(m = 0;m < 8;m ++)
					{
						LCD12864_Data(JLX12864G.LcdRam[i][8 * (j * 8 + k) + m]);
					}
					JLX12864G.BitMapNeedUpdate[i][j] &= ~(1 << k);
					LCD12864_CS(HIGH);
				}
			}
		}
	}
	
	return 0x00;
}
/*
****************************************************
*  Function       : LCD12864SetPixel
*  Description    : 画点函数
*  Calls          : 
*  Called By      : 
*  Input          : x y：坐标color颜色（0xff黑色，0x00白色）
*  Output         : 
*  Return         : 
*  Others         : 
*****************************************************
*/
uint8_t LCD12864SetPixel(uint8_t x,uint8_t y,uint8_t color)
{
	uint8_t temp = 0x00;
	if(color == 0xFF)temp = 0xff;
	if(color == 0x00)temp = 0x00;
	LCD12864RamWrite(x,x,y,y,&temp);
}

uint8_t  cheng1[]={
/*-- 文字: 成 --*/
/*-- 宋体 23; 此字体下对应的点阵为：宽 x 高=31x31 --*/
/*-- 高度不是 8 的倍数，现调整为：宽度 x 高度=32x32 --*/
0x00,0x00,0x00,0x00,0x00,0x00,0x00,0x00,0x00,0x00,0x00,0x00,0x00,0x00,0x00,0x0C,
0xFC,0xFC,0x88,0x00,0x00,0x1C,0x78,0xF0,0xE0,0x00,0x80,0x80,0x00,0x00,0x00,0x00,
0x00,0x00,0x00,0x00,0xFF,0xFF,0x83,0x83,0x83,0x83,0x83,0x83,0xC3,0xC3,0x03,0x1F,
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0x01,0x01,0x01,0x03,0x07,0x0F,0x0E,0x1C,0x1F,0x3F,0x30,0x00,0x00,0x00,0x00,0x00};
uint8_t  gong1[]={
/*-- 文字: 功 --*/
/*-- 宋体 23; 此字体下对应的点阵为：宽 x 高=31x31 --*/
/*-- 高度不是 8 的倍数，现调整为：宽度 x 高度=32x32 --*/
0x00,0x00,0x80,0x80,0x80,0x80,0x80,0x80,0x80,0x80,0x80,0x80,0xC0,0xC0,0xC0,0x00,
0x00,0x00,0x00,0xFE,0xFC,0x0C,0x00,0x00,0x00,0x00,0x00,0x00,0x00,0x00,0x00,0x00,
0x00,0x00,0x00,0x00,0x00,0x00,0x00,0xFF,0xFF,0x00,0x00,0x00,0x00,0x0C,0x04,0x04,
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0x04,0x0C,0x0C,0x1C,0x38,0x3C,0x1F,0x0F,0x01,0x00,0x00,0x00,0x00,0x00,0x00,0x00};
uint8_t  zhuang1[]={
/*-- 文字: 状 --*/
/*-- 宋体 12; 此字体下对应的点阵为：宽 x 高=16x16 --*/
0x08,0x30,0x00,0xFF,0x20,0x20,0x20,0x20,0xFF,0x20,0xE1,0x26,0x2C,0x20,0x20,0x00,
0x04,0x02,0x01,0xFF,0x40,0x20,0x18,0x07,0x00,0x00,0x03,0x0C,0x30,0x60,0x20,0x00};
uint8_t  tai1[]={
/*-- 文字: 态 --*/
/*-- 宋体 12; 此字体下对应的点阵为：宽 x 高=16x16 --*/
0x00,0x04,0x04,0x04,0x84,0x44,0x34,0x4F,0x94,0x24,0x44,0x84,0x84,0x04,0x00,0x00,
0x00,0x60,0x39,0x01,0x00,0x3C,0x40,0x42,0x4C,0x40,0x40,0x70,0x04,0x09,0x31,0x00};
uint8_t  shi1[]={
/*-- 文字: 使 --*/
/*-- 宋体 12; 此字体下对应的点阵为：宽 x 高=16x16 --*/
0x40,0x20,0xF0,0x1C,0x07,0xF2,0x94,0x94,0x94,0xFF,0x94,0x94,0x94,0xF4,0x04,0x00,
0x00,0x00,0x7F,0x00,0x40,0x41,0x22,0x14,0x0C,0x13,0x10,0x30,0x20,0x61,0x20,0x00};
uint8_t  yong1[]={
/*-- 文字: 用 --*/
/*-- 宋体 12; 此字体下对应的点阵为：宽 x 高=16x16 --*/
0x00,0x00,0x00,0xFE,0x22,0x22,0x22,0x22,0xFE,0x22,0x22,0x22,0x22,0xFE,0x00,0x00,
0x80,0x40,0x30,0x0F,0x02,0x02,0x02,0x02,0xFF,0x02,0x02,0x42,0x82,0x7F,0x00,0x00};
uint8_t  bmp_12864_1[]={
/*-- 调入了一幅图像：D:\e\新开发部\显示图案收藏\12864G-202 回字框.bmp --*/
/*-- 宽度 x 高度=128x64 --*/
0x00,0x00,0x00,0x00,0x00,0x00,0x00,0x00,0x80,0xC0,0xE0,0xE0,0xF0,0xF8,0xF8,0xF8,
0xFC,0x7C,0x7C,0x7C,0x7C,0x7C,0xFC,0xF8,0xF8,0xF8,0xF0,0xE0,0xE0,0xC0,0x80,0x00,
0x00,0x00,0x00,0x00,0x00,0x00,0x00,0x00,0x00,0x00,0xF8,0xF8,0xF8,0xF8,0xF8,0xF8,
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0x00,0x01,0x03,0x03,0x07,0x0F,0x0F,0x0F,0x07,0x00,0x00,0x00,0x00,0x00,0x00,0x00
};


